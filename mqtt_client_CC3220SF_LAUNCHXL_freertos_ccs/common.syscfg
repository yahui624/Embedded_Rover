/**
 * @cliArgs --board "/ti/boards/CC3220SF_LAUNCHXL" --product "simplelink_cc32xx_sdk@4_10_00_07"
 * @versions {"data":"2020021217","timestamp":"2020021217","tool":"1.4.0+1234","templates":"2020021217"}
 */

/**
 * Import the modules used in this configuration.
 */
const DriverLib      = scripting.addModule("/ti/devices/DriverLib");
const ADC            = scripting.addModule("/ti/drivers/ADC", {}, false);
const ADC1           = ADC.addInstance();
const Board          = scripting.addModule("/ti/drivers/Board");
const Crypto         = scripting.addModule("/ti/drivers/Crypto");
const Crypto1        = Crypto.addInstance();
const DMA            = scripting.addModule("/ti/drivers/DMA");
const GPIO           = scripting.addModule("/ti/drivers/GPIO");
const GPIO1          = GPIO.addInstance();
const GPIO2          = GPIO.addInstance();
const GPIO3          = GPIO.addInstance();
const GPIO4          = GPIO.addInstance();
const GPIO5          = GPIO.addInstance();
const GPIO6          = GPIO.addInstance();
const GPIO7          = GPIO.addInstance();
const GPIO8          = GPIO.addInstance();
const GPIO9          = GPIO.addInstance();
const PWM            = scripting.addModule("/ti/drivers/PWM", {}, false);
const PWM1           = PWM.addInstance();
const Power          = scripting.addModule("/ti/drivers/Power");
const SPI            = scripting.addModule("/ti/drivers/SPI");
const SPI1           = SPI.addInstance();
const Timer          = scripting.addModule("/ti/drivers/Timer");
const Timer1         = Timer.addInstance();
const Timer2         = Timer.addInstance();
const Timer3         = Timer.addInstance();
const Timer4         = Timer.addInstance();
const UART           = scripting.addModule("/ti/drivers/UART", {}, false);
const UART1          = UART.addInstance();
const UART2          = UART.addInstance();
const Watchdog       = scripting.addModule("/ti/drivers/Watchdog");
const Watchdog1      = Watchdog.addInstance();
const SimpleLinkWifi = scripting.addModule("/ti/drivers/net/wifi/SimpleLinkWifi");
const SlNet          = scripting.addModule("/ti/net/SlNet");
const SlNet1         = SlNet.addInstance();

/**
 * Write custom configuration values to the imported modules.
 */
ADC1.$name              = "CONFIG_ADC_0";
ADC1.adc.$name          = "MyADC1";
ADC1.adc.adcPin.$assign = "boosterpack.26";

Crypto1.$name = "CONFIG_Crypto_0";

GPIO1.$name = "CONFIG_GPIO_0";
GPIO1.mode  = "Output";

GPIO2.$name = "CONFIG_GPIO_1";
GPIO2.mode  = "Output";

GPIO3.$name = "CONFIG_GPIO_2";
GPIO3.mode  = "Output";

GPIO4.$name = "CONFIG_GPIO_3";
GPIO4.mode  = "Output";

GPIO5.$name = "CONFIG_GPIO_4";
GPIO5.mode  = "Output";

GPIO6.$name = "CONFIG_GPIO_5";
GPIO6.mode  = "Output";

GPIO7.$name              = "SLAVE_SELECT1";
GPIO7.mode               = "Output";
GPIO7.initialOutputState = "High";
GPIO7.gpioPin.$assign    = "boosterpack.30";

GPIO8.mode               = "Output";
GPIO8.initialOutputState = "High";
GPIO8.$name              = "SLAVE_SELECT3";
GPIO8.gpioPin.$assign    = "boosterpack.18";

GPIO9.$name              = "SLAVE_SELECT2";
GPIO9.mode               = "Output";
GPIO9.initialOutputState = "High";
GPIO9.gpioPin.$assign    = "boosterpack.19";

PWM1.$name                = "CONFIG_PWM_GRIPPER";
PWM1.timer.$name          = "MyTimer1";
PWM1.timer.pwmPin.$assign = "boosterpack.13";

Power.ioRetentionShutdown = ["GRP_1"];
Power.parkPins.$name      = "ti_drivers_power_PowerCC32XXPins0";

SPI1.$name                = "CONFIG_SPI_0";
SPI1.defaultTxBufferValue = "0";
SPI1.spi.$name            = "MySPI1";

Timer1.$name       = "CONFIG_TIMER_IR";
Timer1.timer.$name = "MyTimer1";

Timer2.$name       = "CONFIG_TIMER_STATISTICS";
Timer2.timerType   = "32 Bits";
Timer2.timer.$name = "MyTimer1";

Timer3.$name       = "CONFIG_TIMER_ENCODERS";
Timer3.timer.$name = "MyTimer1";

Timer4.$name       = "CONFIG_TIMER_MOVEMENT";
Timer4.timerType   = "32 Bits";
Timer4.timer.$name = "MyTimer1";

UART1.$name              = "CONFIG_UART_MOTOR";
UART1.dataDirection      = "Send Only";
UART1.uart.$name         = "MyUART1";
UART1.uart.txPin.$assign = "boosterpack.4";

UART2.$name      = "CONFIG_UART_0";
UART2.$hardware  = system.deviceData.board.components.XDS110UART;
UART2.uart.$name = "MyUART1";

Watchdog1.$name            = "CONFIG_WATCHDOG_0";
Watchdog1.watchdog.$name   = "MyWATCHDOG1";
Watchdog1.watchdog.$assign = "WATCHDOG0";

SlNet1.$name  = "CONFIG_SLNET";
SlNet1.ifName = "CC32xx";

/**
 * Pinmux solution for unlocked pins/peripherals. This ensures that minor changes to the automatic solver in a future
 * version of the tool will not impact the pinmux you originally saw.  These lines can be completely deleted in order to
 * re-solve from scratch.
 */
ADC1.adc.$suggestSolution              = "ADC0";
GPIO1.gpioPin.$suggestSolution         = "45";
GPIO2.gpioPin.$suggestSolution         = "53";
GPIO3.gpioPin.$suggestSolution         = "58";
GPIO4.gpioPin.$suggestSolution         = "60";
GPIO5.gpioPin.$suggestSolution         = "61";
GPIO6.gpioPin.$suggestSolution         = "62";
PWM1.timer.$suggestSolution            = "Timer1";
SPI1.spi.$suggestSolution              = "SPI0";
SPI1.spi.sclkPin.$suggestSolution      = "5";
SPI1.spi.misoPin.$suggestSolution      = "6";
SPI1.spi.mosiPin.$suggestSolution      = "7";
SPI1.spi.dmaRxChannel.$suggestSolution = "UDMA_CH30";
SPI1.spi.dmaTxChannel.$suggestSolution = "UDMA_CH31";
Timer1.timer.$suggestSolution          = "Timer2";
Timer2.timer.$suggestSolution          = "Timer3";
Timer3.timer.$suggestSolution          = "Timer2";
Timer4.timer.$suggestSolution          = "Timer0";
UART1.uart.$suggestSolution            = "UART0";
UART2.uart.$suggestSolution            = "UART1";
UART2.uart.txPin.$suggestSolution      = "55";
UART2.uart.rxPin.$suggestSolution      = "57";
